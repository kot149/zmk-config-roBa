## config/west.yml
```yaml
manifest:
  remotes:
    - name: zmkfirmware
      url-base: https://github.com/zmkfirmware
    - name: inorichi
      url-base: https://github.com/inorichi
    - name: caksoylar
      url-base: https://github.com/caksoylar
    - name: badjeff
      url-base: https://github.com/badjeff
    - name: urob
      url-base: https://github.com/urob
    - name: ssbb
      url-base: https://github.com/ssbb
    - name: 4mplelab
      url-base: https://github.com/4mplelab
    - name: kot149
      url-base: https://github.com/kot149
    - name: te9no
      url-base: https://github.com/te9no
  projects:
    # https://github.com/zmkfirmware/zmk
    - name: zmk
      remote: zmkfirmware
      revision: abb64ba316c29caddc49727ca2cac2f0ed5970c7
      import: app/west.yml

    # # https://github.com/inorichi/zmk-pmw3610-driver
    # - name: zmk-pmw3610-driver
    #   remote: inorichi
    #   revision: main
    #   path: modules/zmk-pmw3610-driver

    # https://github.com/badjeff/zmk-pmw3610-driver
    - name: zmk-pmw3610-driver
      remote: badjeff
      revision: 5c5af40de4d8cdf55dc63c4c5907af1e52da6a95 # zmk-0.3 (2026-11-03)
      path: modules/zmk-pmw3610-driver-badjeff

    # https://github.com/badjeff/zmk-input-processor-report-rate-limit
    - name: zmk-input-processor-report-rate-limit
      remote: badjeff
      revision: f43f37aae7aaa7bf0ec4d432683b873a7e3a8efa # for v0.3-branch
      path: modules/zmk-input-processor-report-rate-limit

    # https://github.com/ssbb/zmk-listeners
    - name: zmk-listeners
      remote: ssbb
      revision: c240ceaf353d3138bea7695eef17049b7ade995b # v1 (2026-11-03)
      path: modules/zmk-listeners

    # https://github.com/caksoylar/zmk-smart-toggle.git
    - name: zmk-smart-toggle
      remote: caksoylar
      revision: 46e178221cccef965a511b772d7bc62800f1542e # v0.3-branch (2026-11-03)
      path: modules/zmk-smart-toggle

    # https://github.com/urob/zmk-adaptive-key
    - name: zmk-adaptive-key
      remote: urob
      revision: 01ccc22889714f276c930dc960a989f80c9e0680 # v0.3
      path: modules/zmk-adaptive-key

    # https://github.com/caksoylar/zmk-rgbled-widget
    - name: zmk-rgbled-widget
      remote: caksoylar
      revision: 8756cb7b8114069fa3c25c6f6c990f24988fceff # v0.3-branch (2026-11-03)
      path: modules/zmk-rgbled-widget

    # https://github.com/4mplelab/zmk-feature-charge-indicator.git
    - name: zmk-feature-charge-indicator
      remote: 4mplelab
      revision: f0d311ed7804cda0e5837ef902f0419aeace4a88 # main (2026-11-03)
      path: modules/zmk-feature-charge-indicator

    # https://github.com/kot149/zmk-mouse-gesture
    - name: zmk-mouse-gesture
      remote: kot149
      revision: 5d80b4489fe6f22d6677984d72d445b5190ef36f # v2 (2026-11-03)
      path: modules/zmk-mouse-gesture

    # https://github.com/kot149/zmk-layout-shift
    - name: zmk-layout-shift
      remote: kot149
      revision: c242c13c9c5a6100b3980b8c725c734c368670de # v2 (2026-11-03)
      path: modules/zmk-layout-shift

    # https://github.com/kot149/zmk-scroll-snap
    - name: zmk-scroll-snap
      remote: kot149
      revision: 2feeb988f5b5a3c2b5e09ba6472e86e6902463a2 # v1 (2026-11-03)
      path: modules/zmk-scroll-snap

    # https://github.com/te9no/zmk-feature-blueboot
    - name: zmk-feature-blueboot
      remote: te9no
      revision: f099518bce4d7d5a06e60ff9ad7e8d66954286ae # main (2026-11-03)
      path: modules/zmk-feature-blueboot

  self:
    path: config
```
