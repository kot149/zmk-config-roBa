## boards/shields/roBa/Kconfig.defconfig
```kconfig
if SHIELD_ROBA_R

    config ZMK_KEYBOARD_NAME
        default "roBa_R"

    config ZMK_SPLIT
        default y

    config ZMK_SPLIT_ROLE_CENTRAL
        default y

    # Fix for prospector scanner
    if ZMK_STATUS_ADVERTISEMENT
        config MIPI_DBI
        bool
    endif

endif

if SHIELD_ROBA_L

    config ZMK_KEYBOARD_NAME
        default "roBa_L"

    config ZMK_SPLIT
        default y

endif
```
